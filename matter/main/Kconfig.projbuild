## matter/main/Kconfig.projbuild
```kconfig
menu "LampSmart bridge"

    config LAMPSMART_CONTROLLER_ID
        hex "LampSmart controller ID"
        range 0x0001 0xFFFF
        default 0x5018
        help
            Controller/group ID captured from the existing LampSmart remote.
            For the v1 protocol, the subgroup nibble is configured separately.

    config LAMPSMART_GROUP_INDEX
        int "LampSmart subgroup index"
        range 0 15
        default 1
        help
            Four-bit subgroup/index captured by the sniffer. The transmitted
            v1 wire group is built from this value and LAMPSMART_CONTROLLER_ID.

endmenu
```

## sniffer/sdkconfig.defaults
```kconfig
CONFIG_BT_ENABLED=y
CONFIG_BT_BLE_ENABLED=y
CONFIG_BT_BLUEDROID_ENABLED=y
CONFIG_BT_BLE_42_FEATURES_SUPPORTED=y
# CONFIG_BT_BLE_50_FEATURES_SUPPORTED is not set

CONFIG_ESPTOOLPY_FLASHSIZE_4MB=y
CONFIG_ESP_CONSOLE_USB_SERIAL_JTAG=y
# CONFIG_ESP_CONSOLE_UART_DEFAULT is not set

CONFIG_ESP_MAIN_TASK_STACK_SIZE=6144
CONFIG_LOG_DEFAULT_LEVEL_INFO=y
```
